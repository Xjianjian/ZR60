; *************************************************************
; *** Scatter-Loading Description File generated by uVision ***
; *************************************************************

LR_IROM1 0x08000000 0x0005FFFF  {    ; load region size_region
  ER_IROM1 0x08000000 0x0005FFFF  {  ; load address = execution address
   *.o (RESET, +First)
   *(InRoot$$Sections)
   .ANY (+RO)
  }
  RW_IRAM1 0x20000000 0x00020000  {  ; RW data
    startup_stm32f40xx.o (+ZI +RW)
    system_stm32f4xx.o (+ZI +RW)
    misc.o (+ZI +RW)
    stm32f4xx_adc.o (+ZI +RW)
    stm32f4xx_can.o (+ZI +RW)
    stm32f4xx_cec.o (+ZI +RW)
    stm32f4xx_crc.o (+ZI +RW)
    stm32f4xx_cryp.o (+ZI +RW)
    stm32f4xx_cryp_aes.o (+ZI +RW)
    stm32f4xx_cryp_des.o (+ZI +RW)
    stm32f4xx_cryp_tdes.o (+ZI +RW)
    stm32f4xx_dac.o (+ZI +RW)
    stm32f4xx_dbgmcu.o (+ZI +RW)
    stm32f4xx_dcmi.o (+ZI +RW)
    stm32f4xx_dma.o (+ZI +RW)
    stm32f4xx_exti.o (+ZI +RW)
    stm32f4xx_flash.o (+ZI +RW)
    stm32f4xx_flash_ramfunc.o (+ZI +RW)
    stm32f4xx_fmpi2c.o (+ZI +RW)
    stm32f4xx_fsmc.o (+ZI +RW)
    stm32f4xx_gpio.o (+ZI +RW)
    stm32f4xx_hash.o (+ZI +RW)
    stm32f4xx_hash_md5.o (+ZI +RW)
    stm32f4xx_hash_sha1.o (+ZI +RW)
    stm32f4xx_i2c.o (+ZI +RW)
    stm32f4xx_iwdg.o (+ZI +RW)
    stm32f4xx_pwr.o (+ZI +RW)
    stm32f4xx_qspi.o (+ZI +RW)
    stm32f4xx_rcc.o (+ZI +RW)
    stm32f4xx_rng.o (+ZI +RW)
    stm32f4xx_rtc.o (+ZI +RW)
    stm32f4xx_sai.o (+ZI +RW)
    stm32f4xx_sdio.o (+ZI +RW)
    stm32f4xx_spdifrx.o (+ZI +RW)
    stm32f4xx_spi.o (+ZI +RW)
    stm32f4xx_syscfg.o (+ZI +RW)
    stm32f4xx_tim.o (+ZI +RW)
    stm32f4xx_usart.o (+ZI +RW)
    stm32f4xx_wwdg.o (+ZI +RW)
    diskio.o (+ZI +RW)
    cc936.o (+ZI +RW)
    ff.o (+ZI +RW)
    tm_stm32f4_fatfs.o (+ZI +RW)
    fatfs_flash_spi.o (+ZI +RW)
    bsp_debug_usart.o (+ZI +RW)
    bsp_i2c_gpio.o (+ZI +RW)
    bsp_led.o (+ZI +RW)
    bsp_SysTick.o (+ZI +RW)
    bsp_wm8978.o (+ZI +RW)
    bsp_clkconfig.o (+ZI +RW)
    bsp_iwdg.o (+ZI +RW)
    bsp_adc.o (+ZI +RW)
    netconf.o (+ZI +RW)
    api_lib.o (+ZI +RW)
    api_msg.o (+ZI +RW)
    err.o (+ZI +RW)
    netbuf.o (+ZI +RW)
    netdb.o (+ZI +RW)
    netifapi.o (+ZI +RW)
    sockets.o (+ZI +RW)
    tcpip.o (+ZI +RW)
    autoip.o (+ZI +RW)
    icmp.o (+ZI +RW)
    igmp.o (+ZI +RW)
    inet.o (+ZI +RW)
    inet_chksum.o (+ZI +RW)
    ip.o (+ZI +RW)
    ip_addr.o (+ZI +RW)
    ip_frag.o (+ZI +RW)
    def.o (+ZI +RW)
    dhcp.o (+ZI +RW)
    dns.o (+ZI +RW)
    init.o (+ZI +RW)
    mem.o (+ZI +RW)
    memp.o (+ZI +RW)
    netif.o (+ZI +RW)
    pbuf.o (+ZI +RW)
    raw.o (+ZI +RW)
    stats.o (+ZI +RW)
    sys.o (+ZI +RW)
    tcp.o (+ZI +RW)
    tcp_in.o (+ZI +RW)
    tcp_out.o (+ZI +RW)
    timers.o (+ZI +RW)
    udp.o (+ZI +RW)
    etharp.o (+ZI +RW)
    ethernetif.o (+ZI +RW)
    LAN8742A.o (+ZI +RW)
    stm32f429_eth.o (+ZI +RW)
    dhcpClient.o (+ZI +RW)
    sys_arch.o (+ZI +RW)
    NetConnIf.o (+ZI +RW)
    NetConnIf_Cfg.o (+ZI +RW)
    cJSON.o (+ZI +RW)
    Mcu_Init.o (+ZI +RW)
    crc32.o (+ZI +RW)
    main.o (+ZI +RW)
    stm32f4xx_it.o (+ZI +RW)
    SleepMng.o (+ZI +RW)
   .ANY (+RW +ZI)
  }
  RW_IRAM2 0x10000000 0x00010000  {
   .ANY (+RW +ZI)
  }
}

